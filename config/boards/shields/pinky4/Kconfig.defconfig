## config/boards/shields/pinky4/Kconfig.defconfig
```kconfig
# Copyright (c) 2020 The ZMK Contributors
# SPDX-License-Identifier: MIT

if SHIELD_pinkie4_LEFT

config ZMK_KEYBOARD_NAME
    default "pinkie4"

config ZMK_SPLIT_ROLE_CENTRAL
    default y

endif

if SHIELD_pinkie4_LEFT || SHIELD_pinkie4_RIGHT

config ZMK_SPLIT
    default y

endif
```

## config/boards/shields/pinky4/Kconfig.shield
```kconfig
# Copyright (c) 2020 The ZMK Contributors
# SPDX-License-Identifier: MIT

config SHIELD_pinky4_LEFT
    def_bool $(shields_list_contains,pinky4_left)

config SHIELD_pinky4_RIGHT
    def_bool $(shields_list_contains,pinky4_right)
```
